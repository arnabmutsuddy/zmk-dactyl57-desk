/*
 * Copyright (c) 2020 Ryan Cross, Bruce Jones
 *
 * SPDX-License-Identifier: MIT
 */

#include "dactyl-stabilized.dtsi"

&default_transform {
	col-offset = <7>;
};

&kscan0 {
	col-gpios
		= <&gpio0  9 GPIO_ACTIVE_HIGH>   /* col 0: P0.09 innermost-right */
		, <&gpio0 10 GPIO_ACTIVE_HIGH>   /* col 1: P0.10 */
		, <&gpio1 11 GPIO_ACTIVE_HIGH>   /* col 2: P1.11 */
		, <&gpio1 13 GPIO_ACTIVE_HIGH>   /* col 3: P1.13 */
		, <&gpio1 15 GPIO_ACTIVE_HIGH>   /* col 4: P1.15 */
		, <&gpio0  2 GPIO_ACTIVE_HIGH>   /* col 5: P0.02 */
		, <&gpio0 29 GPIO_ACTIVE_HIGH>   /* col 6: P0.29 outermost-right */
		;
};
